## meta-magicbox/conf/layer.conf
```bitbake
BBPATH .= ":${LAYERDIR}"
BBFILES += "${LAYERDIR}/recipes-*/*/*.bb ${LAYERDIR}/recipes-*/*/*.bbappend"
BBFILE_COLLECTIONS += "magicbox"
BBFILE_PATTERN_magicbox = "^${LAYERDIR}/"
BBFILE_PRIORITY_magicbox = "20"
LAYERSERIES_COMPAT_magicbox = "hardknott"
LAYERDEPENDS_magicbox = "core openpli-layer"
```
